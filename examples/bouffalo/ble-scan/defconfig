## examples/bouffalo/usb-cdc/defconfig
```kconfig
CONFIG_FREERTOS             =y
CONFIG_CHERRYUSB            =y
CONFIG_CHERRYUSB_OSAL       =freertos
CONFIG_CHERRYUSB_DEVICE     =y
CONFIG_CHERRYUSB_DEVICE_CDC_ACM =y
CONFIG_VSNPRINTF_FLOAT      =y
CONFIG_VSNPRINTF_FLOAT_EX   =y
CONFIG_VSNPRINTF_LONG_LONG  =y
CONFIG_BFLB_LOG             =n
```
